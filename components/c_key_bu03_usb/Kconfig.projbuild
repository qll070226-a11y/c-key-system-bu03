## components/c_key_bu03_usb/Kconfig.projbuild
```kconfig
menu "C题 BU03-Kit USB身份接收"

config C_KEY_BU03_USB_VID
    hex "BU03主USB VID"
    default 0x0483

config C_KEY_BU03_USB_PID
    hex "BU03主USB PID"
    default 0x5740

config C_KEY_BU03_ID_TIMEOUT_MS
    int "真实Tag ID有效期(ms)"
    range 100 5000
    default 500

config C_KEY_ALLOW_ID_FALLBACK
    bool "调试：USB身份缺失时使用门锁拨码ID"
    default n
    help
        仅用于主USB身份线尚未接通时调试测距、定位和显示。
        开启后若没有近期真实Tag ID，固件会临时使用门锁当前拨码ID。
        该模式不能验证数字钥匙身份，不符合最终验收要求；完成USB接线后必须关闭。

endmenu
```

## components/c_key_io/Kconfig.projbuild
```kconfig
menu "C题 门锁GPIO配置"

config C_KEY_DIP_BIT0_GPIO
    int "4位拨码 bit0 GPIO（-1禁用）"
    range -1 48
    default 4

config C_KEY_DIP_BIT1_GPIO
    int "4位拨码 bit1 GPIO（-1禁用）"
    range -1 48
    default 5

config C_KEY_DIP_BIT2_GPIO
    int "4位拨码 bit2 GPIO（-1禁用）"
    range -1 48
    default 6

config C_KEY_DIP_BIT3_GPIO
    int "4位拨码 bit3 GPIO（-1禁用）"
    range -1 48
    default 7

config C_KEY_RED_LED_GPIO
    int "闭锁红灯GPIO（-1禁用）"
    range -1 48
    default 15

config C_KEY_GREEN_LED_GPIO
    int "开锁绿灯GPIO（-1禁用）"
    range -1 48
    default 16

config C_KEY_WELCOME_LED_GPIO
    int "迎宾灯GPIO（-1禁用）"
    range -1 48
    default 17

config C_KEY_BUZZER_GPIO
    int "蜂鸣器驱动GPIO（-1禁用）"
    range -1 48
    default 8

config C_KEY_OUTPUT_ACTIVE_HIGH
    bool "LED与蜂鸣器高电平有效"
    default y

config C_KEY_DIP_DEBOUNCE_MS
    int "拨码去抖时间(ms)"
    range 5 500
    default 30

config C_KEY_BUZZER_PULSE_MS
    int "进入迎宾区蜂鸣持续时间(ms)"
    range 50 5000
    default 500

endmenu
```

## components/c_key_tft/Kconfig.projbuild
```kconfig
menu "C题 2.4英寸SPI TFT"

config C_KEY_TFT_ENABLE
    bool "启用LVSN-TFT-2.4显示"
    default y

if C_KEY_TFT_ENABLE

choice C_KEY_TFT_CONTROLLER
    prompt "LCD控制器"
    default C_KEY_TFT_CONTROLLER_ILI9341

config C_KEY_TFT_CONTROLLER_ILI9341
    bool "ILI9341（2.4英寸240x320常见方案）"

config C_KEY_TFT_CONTROLLER_ST7789
    bool "ST7789"

endchoice

config C_KEY_TFT_MOSI_GPIO
    int "TFT SDI/MOSI GPIO"
    range 0 48
    default 11

config C_KEY_TFT_SCLK_GPIO
    int "TFT CLK GPIO"
    range 0 48
    default 12

config C_KEY_TFT_MISO_GPIO
    int "TFT SDO/MISO GPIO（-1不连接）"
    range -1 48
    default 13

config C_KEY_TFT_CS_GPIO
    int "TFT CS GPIO"
    range 0 48
    default 10

config C_KEY_TFT_DC_GPIO
    int "TFT D/C GPIO"
    range 0 48
    default 9

config C_KEY_TFT_BL_GPIO
    int "TFT BLK背光GPIO（-1表示直接接电源）"
    range -1 48
    default 14

config C_KEY_TFT_BL_ACTIVE_HIGH
    bool "TFT背光高电平开启"
    default y

config C_KEY_TFT_CLOCK_MHZ
    int "TFT SPI时钟(MHz)"
    range 1 40
    default 20

endif

endmenu
```

## main/Kconfig.projbuild
```kconfig
menu "C题 BU04 PDOA数字钥匙"

config BU04_UART_NUM
    int "BU04 UART控制器编号"
    range 1 2
    default 1
    help
        UART0保留给下载和调试日志，BU04默认使用UART1。

config BU04_UART_TX_GPIO
    int "可选：ESP32连接BU04 UART2_RX的TX GPIO（-1禁用）"
    range -1 48
    default -1
    help
        当前固件只读取BU04 UART2_TX，默认不连接反向串口。

config BU04_UART_RX_GPIO
    int "ESP32连接BU04 UART2_TX的RX GPIO"
    range 0 48
    default 18

config BU04_UART_BAUD_RATE
    int "BU04 UART2波特率"
    range 1200 2000000
    default 115200

config BU04_SIGNAL_TIMEOUT_MS
    int "无有效PDOA帧后闭锁时间(ms)"
    range 100 5000
    default 500

config BU04_ENABLE_RAW_CAPTURE
    bool "输出原始UART数据用于协议诊断"
    default n

config BU04_IDLE_FLUSH_MS
    int "原始数据空闲切帧时间(ms)"
    range 5 1000
    default 50

config BU04_FRAME_BUFFER_SIZE
    int "原始数据缓冲区大小"
    range 128 4096
    default 1024

config C_KEY_PDOA_TAG_ADDRESS
    hex "已配对BU03标签短地址"
    range 0x0000 0xFFFF
    default 0x6E19

config C_KEY_LOGICAL_TAG_ID
    int "该标签对应的四位逻辑钥匙ID"
    range 0 15
    default 0

config C_KEY_ACCEPTED_ID_DEFAULT
    int "拨码开关不可用时的门锁ID"
    range 0 15
    default 0

menu "PDOA定位标定与滤波"

config C_KEY_PDOA_DISTANCE_SCALE_PPM
    int "BU04距离比例系数(ppm)"
    range 900000 1100000
    default 1000000

config C_KEY_PDOA_DISTANCE_OFFSET_MM
    int "BU04距离偏移(mm)"
    range -1000 1000
    default 0

config C_KEY_DOOR_RADIUS_MM
    int "门锁圆柱边界半径(mm)"
    range 0 300
    default 300

config C_KEY_FRONT_OFFSET_DEG
    int "BU04安装正前方角度零偏(deg)"
    range -180 180
    default 0

config C_KEY_FILTER_ALPHA_PERCENT
    int "距离EMA滤波系数百分比"
    range 1 100
    default 35

config C_KEY_ANGLE_FILTER_STATIONARY_ALPHA_PERCENT
    int "静止角度EMA滤波系数百分比"
    range 1 100
    default 15

config C_KEY_ANGLE_FILTER_MOVING_ALPHA_PERCENT
    int "移动角度EMA滤波系数百分比"
    range 1 100
    default 60

config C_KEY_ANGLE_FILTER_MOTION_THRESHOLD_DEG
    int "角度快速跟随阈值(deg)"
    range 1 90
    default 3

endmenu

endmenu
```

## sdkconfig.defaults
```kconfig
CONFIG_ESP_MAIN_TASK_STACK_SIZE=4096
CONFIG_LOG_DEFAULT_LEVEL_INFO=y
CONFIG_COMPILER_OPTIMIZATION_DEBUG=y
CONFIG_ESPTOOLPY_FLASHSIZE_16MB=y
CONFIG_BU04_UART_NUM=1
CONFIG_BU04_UART_TX_GPIO=-1
CONFIG_BU04_UART_RX_GPIO=18
CONFIG_BU04_UART_BAUD_RATE=115200
CONFIG_BU04_SIGNAL_TIMEOUT_MS=500
CONFIG_C_KEY_PDOA_TAG_ADDRESS=0x6E19
CONFIG_C_KEY_LOGICAL_TAG_ID=0
CONFIG_C_KEY_ACCEPTED_ID_DEFAULT=0
CONFIG_C_KEY_PDOA_DISTANCE_SCALE_PPM=1000000
CONFIG_C_KEY_PDOA_DISTANCE_OFFSET_MM=0
CONFIG_C_KEY_DOOR_RADIUS_MM=300
CONFIG_C_KEY_FRONT_OFFSET_DEG=0
CONFIG_C_KEY_FILTER_ALPHA_PERCENT=35
CONFIG_C_KEY_ANGLE_CAL_RAW_NEG15_TENTHS=-123
CONFIG_C_KEY_ANGLE_CAL_RAW_NEG30_TENTHS=-282
CONFIG_C_KEY_ANGLE_CAL_RAW_NEG45_TENTHS=-415
CONFIG_C_KEY_ANGLE_ONE_EURO_MIN_CUTOFF_CENTIHZ=80
CONFIG_C_KEY_ANGLE_ONE_EURO_BETA_MILLI=30
CONFIG_C_KEY_ANGLE_ONE_EURO_DERIVATIVE_CUTOFF_CENTIHZ=100
CONFIG_C_KEY_ANGLE_HAMPEL_SIGMA_TENTHS=30
CONFIG_C_KEY_ANGLE_HAMPEL_MIN_THRESHOLD_DEG=12
CONFIG_C_KEY_ANGLE_HAMPEL_MAX_REJECTIONS=3
CONFIG_C_KEY_BUZZER_ACTIVE_LOW=y
```
